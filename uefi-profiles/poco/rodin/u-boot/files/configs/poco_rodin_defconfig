## uefi-profiles/poco/rodin/u-boot/files/configs/poco_rodin_defconfig
```kconfig
# Minimal RAM-only U-Boot defconfig for POCO X7 Pro (rodin / MT6899).
# Chainloaded at EL1 from MediaTek LK (GenieZone owns EL2).
CONFIG_ARM=y
CONFIG_CMO_BY_VA_ONLY=y
CONFIG_SKIP_LOWLEVEL_INIT=y
CONFIG_ENABLE_ARM_SOC_BOOT0_HOOK=y
CONFIG_COUNTER_FREQUENCY=13000000
CONFIG_POSITION_INDEPENDENT=y
CONFIG_ARCH_MEDIATEK=y
CONFIG_TARGET_MT8195=y
CONFIG_MTK_MEM_MAP_DDR_BASE_PHY=0x40000000
CONFIG_MTK_MEM_MAP_DDR_SIZE=0x300000000
CONFIG_MTK_MEM_MAP_MMIO_SIZE=0x20000000
CONFIG_TEXT_BASE=0x4c000000
CONFIG_NR_DRAM_BANKS=2
CONFIG_SYS_MALLOC_LEN=0x2000000
CONFIG_SYS_MALLOC_F_LEN=0x16000
CONFIG_SYS_LOAD_ADDR=0x60000000
CONFIG_DEFAULT_DEVICE_TREE="mediatek/mt6899-poco-rodin"
CONFIG_OF_UPSTREAM=y
CONFIG_SAVE_PREV_BL_FDT_ADDR=y
CONFIG_SAVE_PREV_BL_INITRAMFS_START_ADDR=y
CONFIG_ENV_USE_DEFAULT_ENV_TEXT_FILE=y
CONFIG_ENV_DEFAULT_ENV_TEXT_FILE="board/mediatek/hakios-rodin.env"
# CONFIG_DISPLAY_CPUINFO is not set
# CONFIG_BOARD_INIT is not set
CONFIG_BOARD_EARLY_INIT_R=y
CONFIG_BOARD_LATE_INIT=y
CONFIG_HUSH_PARSER=y
CONFIG_EFI_MEDIA=y
CONFIG_EFI_LOADER=y
CONFIG_CMD_HAKIOS=y
CONFIG_CMD_BOOTEFI=y
CONFIG_CMD_SMC=y
CONFIG_CMD_TIME=y
CONFIG_CMD_CACHE=y
CONFIG_CMD_PSTORE=y
CONFIG_CMD_PSTORE_MEM_ADDR=0x6ec00000
CONFIG_CMD_PSTORE_MEM_SIZE=0x410000
CONFIG_CMD_PSTORE_CONSOLE_SIZE=0x200000
CONFIG_CMD_PSTORE_PMSG_SIZE=0x200000
CONFIG_VIDEO=y
CONFIG_VIDEO_SIMPLE=y
CONFIG_SYS_WHITE_ON_BLACK=y
CONFIG_CONSOLE_FLUSH_ON_NEWLINE=y
# CONFIG_VIDEO_LOGO is not set
# CONFIG_VIDEO_FONT_8X16 is not set
CONFIG_VIDEO_FONT_16X32=y
CONFIG_CONSOLE_MUX=y
CONFIG_CONSOLE_RECORD=y
CONFIG_CONSOLE_RECORD_INIT_F=y
CONFIG_CONSOLE_RECORD_OUT_SIZE=0x6000
# CONFIG_REQUIRE_SERIAL_CONSOLE is not set
CONFIG_DM_SERIAL=y
CONFIG_NULLDEV_SERIAL=y
# CONFIG_MMC is not set
# CONFIG_DM_MMC is not set
# CONFIG_NET is not set
# CONFIG_DM_ETH is not set
CONFIG_PANIC_HANG=y
# CONFIG_SYSRESET is not set
CONFIG_ARM_SMCCC=y
# CONFIG_SYSRESET_PSCI is not set
CONFIG_PSCI_RESET=y
# CONFIG_WATCHDOG_AUTOSTART is not set
# CONFIG_EFI_RUNTIME_UPDATE_CAPSULE is not set
# CONFIG_EFI_CAPSULE_ON_DISK is not set
# CONFIG_EFI_CAPSULE_FIRMWARE_RAW is not set
# CONFIG_TOOLS_MKEFICAPSULE is not set
# CONFIG_TOOLS_LIBCRYPTO is not set
# CONFIG_TOOLS_KWBIMAGE is not set
# CONFIG_EFI_HAKIOS_USB_DEVICE is not set
```
